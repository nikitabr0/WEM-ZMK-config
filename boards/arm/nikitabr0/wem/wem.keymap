// This file was generated from a template. Edit it to match your keyboard.
// See https://zmk.dev/docs/development/hardware-integration/new-shield for more instructions.

#include <behaviors.dtsi>
#include <dt-bindings/zmk/keys.h>
#include <dt-bindings/zmk/pointing.h>

/ {
    // Define a default keymap here.
    // See https://zmk.dev/docs/development/hardware-integration/new-shield#default-keymap.
    keymap {
        compatible = "zmk,keymap";

        default_layer {
            bindings = <
                &mkp &studio_unlock LCLK &mkp &studio_unlock MCLK &mkp &studio_unlock RCLK &mkp &studio_unlock MB4 &mkp &studio_unlock MB5 &kp &studio_unlock F22
            >;
        };
    };
};
