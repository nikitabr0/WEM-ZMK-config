// This file was generated from a template. Edit it to match your keyboard.
// See https://zmk.dev/docs/development/hardware-integration/new-shield for more instructions.

#include <behaviors.dtsi>
#include <dt-bindings/zmk/keys.h>

/ {
    // Define a default keymap here.
    // See https://zmk.dev/docs/development/hardware-integration/new-shield#default-keymap.
    keymap {
        compatible = "zmk,keymap";

        default_layer {
            bindings = <
                &kp &studio_unlock A &kp &studio_unlock B &kp &studio_unlock C &kp &studio_unlock D &kp &studio_unlock E &kp &studio_unlock F
            >;
        };
    };
};
